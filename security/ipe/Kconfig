## security/ipe/Kconfig
```kconfig
config SECURITY_IPE
	bool "Policy based integrity protection enforcement of code and data."
	depends on SECURITY && BLOCK && AUDIT
	depends on DM_VERITY_VERIFY_ROOTHASH_SIG='y'
	depends on DM_VERITY='y'
	help
	  Any processes going to be executed (binaries or
	  shared libraries mmaped) or data files that are read should have
	  integrity requirements. The IPE will check the requirements on the
	  basis of a policy and enforce various deterministic properties of
	  a file/process.
	  When enabled, any files/processes that do not satisy the policy
	  will be blocked.
config SECURITY_IPE_TRUST_BOOT
	bool "Trust the boot chain to do verification of the initial disk"
	depends on SECURITY_IPE
	help
	  Forces trust of the initial disk. When enabled, the first disk
	  that calls into any IPE hook will be pinned and marked as DMVerity
	  verified, using the same logic as loadpin. As a result, IPE will
	  assume that this device is trusted as if it was a verified verity
	  volume.
config SECURITY_IPE_DISABLE_AUDIT
	bool "Disable the ability to switch to audit mode"
	depends on SECURITY_IPE
	help
	  Disables all command-line parameters and sysctls that control the
	  audit mode functionality of IPE. When enabled, enforcement mode is
	  forced on, and cannot be changed.
```
